/ {
    behaviors {
        /delete-node/ zmk_behavior_momentary_layer;

        mom: behavior_momentary_layer {
            compatible = "zmk,behavior-momentary-layer";
            label = "MOMENTARY";
        };
    };
};
