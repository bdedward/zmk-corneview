#include "corne_left.overlay"

&spi1 {
    status = "okay";
    cs-gpios = <&gpio0 6 GPIO_ACTIVE_LOW>; // P0.06 for CS

    nice_view: ls0xx@0 {
        compatible = "ls0xx";
        reg = <0>;
        spi-max-frequency = <10000000>;
        width = <128>;
        height = <64>;
        label = "NiceView";
    };
};

&{/chosen} {
    zephyr,display = &nice_view;
};
